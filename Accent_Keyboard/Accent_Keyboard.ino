#include <Adafruit_GFX.h>
#include <Adafruit_ST7789.h>
#include <SPI.h>
#include <BleKeyboard.h>

#define TFT_CS 26    //CS on display
#define TFT_RST 2    //arduino rst pin; RES on display
#define TFT_DC 32    //DC on display
#define TFT_MOSI 19  //SDA on display
#define TFT_SCLK 18  //SCL on display

Adafruit_ST7789 tft = Adafruit_ST7789(TFT_CS, TFT_DC, TFT_MOSI, TFT_SCLK, TFT_RST);

BleKeyboard bleKeyboard("Accent Keyboard", "Enzo_R", 100);

const int buttonRows[3] = { 23, 22, 21 };
const int buttonColumns[4] = { 12, 13, 14, 15 };


// 'deg', 34x32px
const unsigned char epd_bitmap_deg[] PROGMEM = {
  0x00, 0x00, 0x00, 0x00, 0x00, 0x00, 0x0f, 0xfe, 0x00, 0x00, 0x00, 0x7f, 0xff, 0x80, 0x00, 0x00,
  0xff, 0xff, 0xe0, 0x00, 0x03, 0xff, 0xff, 0xf0, 0x00, 0x07, 0xff, 0xff, 0xf8, 0x00, 0x0f, 0xff,
  0xff, 0xfc, 0x00, 0x1f, 0xff, 0xff, 0xfe, 0x00, 0x1f, 0xff, 0xff, 0xff, 0x00, 0x3f, 0xfc, 0x0f,
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  0x00, 0x00, 0x7f, 0xff, 0x80, 0x00, 0x00, 0x1f, 0xfc, 0x00, 0x00, 0x00, 0x00, 0x00, 0x00, 0x00
};
// 'Ndown', 52x85px
const unsigned char epd_bitmap_Ndown[] PROGMEM = {
  0x00, 0x00, 0x00, 0x00, 0x00, 0x00, 0x00, 0x00, 0x07, 0xfe, 0x00, 0x01, 0xfe, 0x00, 0x00, 0x1f,
  0xff, 0x80, 0x01, 0xfe, 0x00, 0x00, 0x3f, 0xff, 0xe0, 0x01, 0xfe, 0x00, 0x00, 0x7f, 0xff, 0xf0,
  0x03, 0xfe, 0x00, 0x00, 0xff, 0xff, 0xfc, 0x03, 0xfe, 0x00, 0x01, 0xff, 0xff, 0xfe, 0x07, 0xfe,
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  0x00, 0x00, 0x00
};
// 'Cdown', 45x83px
const unsigned char epd_bitmap_Cdown[] PROGMEM = {
  0x00, 0x00, 0x00, 0x00, 0x00, 0x00, 0x00, 0x00, 0x0f, 0xff, 0xc0, 0x00, 0x00, 0x00, 0x7f, 0xff,
  0xf8, 0x00, 0x00, 0x01, 0xff, 0xff, 0xff, 0x00, 0x00, 0x07, 0xff, 0xff, 0xff, 0x80, 0x00, 0x0f,
  0xff, 0xff, 0xff, 0xe0, 0x00, 0x3f, 0xff, 0xff, 0xff, 0xe0, 0x00, 0x7f, 0xff, 0xff, 0xff, 0xf0,
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  0x00, 0x00
};
// 'dots', 43x16px
const unsigned char epd_bitmap_dots[] PROGMEM = {
  0x00, 0x00, 0x00, 0x00, 0x00, 0x00, 0x1f, 0xf8, 0x00, 0x03, 0xff, 0x00, 0x3f, 0xfc, 0x00, 0x07,
  0xff, 0x80, 0x7f, 0xfe, 0x00, 0x0f, 0xff, 0xc0, 0x7f, 0xfe, 0x00, 0x0f, 0xff, 0xc0, 0x7f, 0xff,
  0x00, 0x1f, 0xff, 0xc0, 0x7f, 0xff, 0x00, 0x1f, 0xff, 0xc0, 0x7f, 0xff, 0x00, 0x1f, 0xff, 0xc0,
  0x7f, 0xff, 0x00, 0x1f, 0xff, 0xc0, 0x7f, 0xff, 0x00, 0x1f, 0xff, 0xc0, 0x7f, 0xfe, 0x00, 0x1f,
  0xff, 0xc0, 0x7f, 0xfe, 0x00, 0x0f, 0xff, 0xc0, 0x7f, 0xfe, 0x00, 0x0f, 0xff, 0x80, 0x3f, 0xfc,
  0x00, 0x07, 0xff, 0x80, 0x1f, 0xf8, 0x00, 0x03, 0xfe, 0x00, 0x00, 0x00, 0x00, 0x00, 0x00, 0x00
};
// 'right', 29x19px
const unsigned char epd_bitmap_right[] PROGMEM = {
  0x00, 0x00, 0x00, 0x00, 0x00, 0x01, 0xff, 0xe0, 0x00, 0x07, 0xff, 0xf0, 0x00, 0x0f, 0xff, 0xf0,
  0x00, 0x0f, 0xff, 0xe0, 0x00, 0x1f, 0xff, 0xc0, 0x00, 0x3f, 0xff, 0x00, 0x00, 0x7f, 0xfe, 0x00,
  0x00, 0xff, 0xfc, 0x00, 0x01, 0xff, 0xf8, 0x00, 0x03, 0xff, 0xf0, 0x00, 0x07, 0xff, 0xe0, 0x00,
  0x0f, 0xff, 0xc0, 0x00, 0x0f, 0xff, 0x80, 0x00, 0x1f, 0xff, 0x00, 0x00, 0x3f, 0xfc, 0x00, 0x00,
  0x7f, 0xf8, 0x00, 0x00, 0x7f, 0xf0, 0x00, 0x00, 0x00, 0x00, 0x00, 0x00
};
// 'left', 29x19px
const unsigned char epd_bitmap_left[] PROGMEM = {
  0x00, 0x00, 0x00, 0x00, 0x3f, 0xfc, 0x00, 0x00, 0x7f, 0xff, 0x00, 0x00, 0x7f, 0xff, 0x80, 0x00,
  0x3f, 0xff, 0xc0, 0x00, 0x0f, 0xff, 0xc0, 0x00, 0x07, 0xff, 0xe0, 0x00, 0x03, 0xff, 0xf0, 0x00,
  0x01, 0xff, 0xf8, 0x00, 0x00, 0xff, 0xfc, 0x00, 0x00, 0x7f, 0xfe, 0x00, 0x00, 0x3f, 0xff, 0x00,
  0x00, 0x1f, 0xff, 0x80, 0x00, 0x0f, 0xff, 0x80, 0x00, 0x03, 0xff, 0xc0, 0x00, 0x01, 0xff, 0xe0,
  0x00, 0x00, 0xff, 0xf0, 0x00, 0x00, 0x7f, 0xf0, 0x00, 0x00, 0x00, 0x00
};
// 'Euro', 59x82px
const unsigned char epd_bitmap_Euro[] PROGMEM = {
  0x00, 0x00, 0x00, 0x00, 0x00, 0x00, 0x00, 0x00, 0x00, 0x00, 0x00, 0x01, 0xff, 0xfe, 0x00, 0x00,
  0x00, 0x00, 0x00, 0x1f, 0xff, 0xff, 0xe0, 0x00, 0x00, 0x00, 0x00, 0x7f, 0xff, 0xff, 0xf8, 0x00,
  0x00, 0x00, 0x01, 0xff, 0xff, 0xff, 0xfe, 0x00, 0x00, 0x00, 0x07, 0xff, 0xff, 0xff, 0xff, 0x00,
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  0x00, 0x00, 0x00, 0x03, 0xff, 0xfe, 0x00, 0x00, 0x00, 0x00, 0x00, 0x00, 0x00, 0x00, 0x00, 0x00
};
// 'Cup', 59x103px
const unsigned char epd_bitmap_Cup[] PROGMEM = {
  0x00, 0x00, 0x00, 0x00, 0x00, 0x00, 0x00, 0x00, 0x00, 0x00, 0x00, 0x07, 0xff, 0xf8, 0x00, 0x00,
  0x00, 0x00, 0x00, 0x7f, 0xff, 0xff, 0x00, 0x00, 0x00, 0x00, 0x03, 0xff, 0xff, 0xff, 0xe0, 0x00,
  0x00, 0x00, 0x0f, 0xff, 0xff, 0xff, 0xf8, 0x00, 0x00, 0x00, 0x3f, 0xff, 0xff, 0xff, 0xfe, 0x00,
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  0x00, 0x00, 0x00, 0x00, 0x00, 0x00, 0x00, 0x00
};
// 'Nup', 66x102px
const unsigned char epd_bitmap_Nup[] PROGMEM = {
  0x00, 0x00, 0x00, 0x00, 0x00, 0x00, 0x00, 0x00, 0x00, 0x00, 0x00, 0x1f, 0xfc, 0x00, 0x03, 0xfc,
  0x00, 0x00, 0x00, 0x00, 0x7f, 0xff, 0x00, 0x03, 0xfe, 0x00, 0x00, 0x00, 0x00, 0xff, 0xff, 0xc0,
  0x03, 0xfe, 0x00, 0x00, 0x00, 0x01, 0xff, 0xff, 0xf0, 0x03, 0xfc, 0x00, 0x00, 0x00, 0x03, 0xff,
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  0x00, 0x00, 0x00, 0x00, 0x00, 0x00
};
// 'Odown', 59x62px
const unsigned char epd_bitmap_Odown[] PROGMEM = {
  0x00, 0x00, 0x00, 0x00, 0x00, 0x00, 0x00, 0x00, 0x00, 0x00, 0x03, 0xff, 0xfe, 0x00, 0x00, 0x00,
  0x00, 0x00, 0x3f, 0xff, 0xff, 0xc0, 0x00, 0x00, 0x00, 0x00, 0xff, 0xff, 0xff, 0xf8, 0x00, 0x00,
  0x00, 0x03, 0xff, 0xff, 0xff, 0xfe, 0x00, 0x00, 0x00, 0x0f, 0xff, 0xff, 0xff, 0xff, 0x00, 0x00,
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  0x00, 0x00, 0x0f, 0xff, 0xf8, 0x00, 0x00, 0x00, 0x00, 0x00, 0x00, 0x00, 0x00, 0x00, 0x00, 0x00
};
// 'Udown', 52x61px
const unsigned char epd_bitmap_Udown[] PROGMEM = {
  0x00, 0x00, 0x00, 0x00, 0x00, 0x00, 0x00, 0x7f, 0xfc, 0x00, 0x00, 0x03, 0xff, 0xc0, 0x7f, 0xfe,
  0x00, 0x00, 0x07, 0xff, 0xe0, 0x7f, 0xfe, 0x00, 0x00, 0x07, 0xff, 0xe0, 0x7f, 0xfe, 0x00, 0x00,
  0x07, 0xff, 0xe0, 0x7f, 0xfe, 0x00, 0x00, 0x07, 0xff, 0xe0, 0x7f, 0xfe, 0x00, 0x00, 0x07, 0xff,
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  0x80, 0x00, 0x00, 0x00, 0x00, 0x00, 0x00, 0x00, 0x00, 0x00, 0x00
};
// 'Edown', 54x62px
const unsigned char epd_bitmap_Edown[] PROGMEM = {
  0x00, 0x00, 0x00, 0x00, 0x00, 0x00, 0x00, 0x00, 0x00, 0x07, 0xff, 0xf0, 0x00, 0x00, 0x00, 0x00,
  0x7f, 0xff, 0xfe, 0x00, 0x00, 0x00, 0x01, 0xff, 0xff, 0xff, 0x80, 0x00, 0x00, 0x07, 0xff, 0xff,
  0xff, 0xe0, 0x00, 0x00, 0x0f, 0xff, 0xff, 0xff, 0xf0, 0x00, 0x00, 0x1f, 0xff, 0xff, 0xff, 0xfc,
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  0x00, 0x00
};
// 'Uup', 65x81px
const unsigned char epd_bitmap_Uup[] PROGMEM = {
  0x00, 0x00, 0x00, 0x00, 0x00, 0x00, 0x00, 0x00, 0x00, 0x3f, 0xfe, 0x00, 0x00, 0x00, 0x00, 0x3f,
  0xfe, 0x00, 0x7f, 0xff, 0x00, 0x00, 0x00, 0x00, 0x7f, 0xff, 0x00, 0x7f, 0xff, 0x00, 0x00, 0x00,
  0x00, 0x7f, 0xff, 0x00, 0x7f, 0xff, 0x00, 0x00, 0x00, 0x00, 0x7f, 0xff, 0x00, 0x7f, 0xff, 0x00,
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  0x00, 0x00, 0x00, 0x00, 0x00, 0x00, 0x00, 0x00, 0x00
};
// 'Oup', 75x82px
const unsigned char epd_bitmap_Oup[] PROGMEM = {
  0x00, 0x00, 0x00, 0x00, 0x00, 0x00, 0x00, 0x00, 0x00, 0x00, 0x00, 0x00, 0x00, 0x07, 0xff, 0xff,
  0x00, 0x00, 0x00, 0x00, 0x00, 0x00, 0x00, 0x7f, 0xff, 0xff, 0xf0, 0x00, 0x00, 0x00, 0x00, 0x00,
  0x03, 0xff, 0xff, 0xff, 0xfe, 0x00, 0x00, 0x00, 0x00, 0x00, 0x0f, 0xff, 0xff, 0xff, 0xff, 0x80,
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  0x00, 0x00, 0x00, 0x00
};
// 'Idown', 16x60px
const unsigned char epd_bitmap_Idown[] PROGMEM = {
  0x00, 0x00, 0x3f, 0xfc, 0x7f, 0xfe, 0x7f, 0xfe, 0x7f, 0xfe, 0x7f, 0xfe, 0x7f, 0xfe, 0x7f, 0xfe,
  0x7f, 0xfe, 0x7f, 0xfe, 0x7f, 0xfe, 0x7f, 0xfe, 0x7f, 0xfe, 0x7f, 0xfe, 0x7f, 0xfe, 0x7f, 0xfe,
  0x7f, 0xfe, 0x7f, 0xfe, 0x7f, 0xfe, 0x7f, 0xfe, 0x7f, 0xfe, 0x7f, 0xfe, 0x7f, 0xfe, 0x7f, 0xfe,
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  0x7f, 0xfe, 0x7f, 0xfe, 0x3f, 0xfc, 0x00, 0x00
};
// 'Iup', 16x80px
const unsigned char epd_bitmap_Iup[] PROGMEM = {
  0x00, 0x00, 0x3f, 0xfc, 0x7f, 0xfe, 0x7f, 0xfe, 0x7f, 0xfe, 0x7f, 0xfe, 0x7f, 0xfe, 0x7f, 0xfe,
  0x7f, 0xfe, 0x7f, 0xfe, 0x7f, 0xfe, 0x7f, 0xfe, 0x7f, 0xfe, 0x7f, 0xfe, 0x7f, 0xfe, 0x7f, 0xfe,
  0x7f, 0xfe, 0x7f, 0xfe, 0x7f, 0xfe, 0x7f, 0xfe, 0x7f, 0xfe, 0x7f, 0xfe, 0x7f, 0xfe, 0x7f, 0xfe,
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  0x7f, 0xfe, 0x7f, 0xfe, 0x7f, 0xfe, 0x7f, 0xfe, 0x7f, 0xfe, 0x7f, 0xfe, 0x3f, 0xfc, 0x00, 0x00
};
// 'Eup', 47x79px
const unsigned char epd_bitmap_Eup[] PROGMEM = {
  0x00, 0x00, 0x00, 0x00, 0x00, 0x00, 0x3f, 0xff, 0xff, 0xff, 0xff, 0xf8, 0x7f, 0xff, 0xff, 0xff,
  0xff, 0xfc, 0x7f, 0xff, 0xff, 0xff, 0xff, 0xfc, 0x7f, 0xff, 0xff, 0xff, 0xff, 0xfc, 0x7f, 0xff,
  0xff, 0xff, 0xff, 0xfc, 0x7f, 0xff, 0xff, 0xff, 0xff, 0xfc, 0x7f, 0xff, 0xff, 0xff, 0xff, 0xfc,
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  0xff, 0xff, 0xff, 0xfc, 0x00, 0x00, 0x00, 0x00, 0x00, 0x00
};
// 'Adown', 50x62px
const unsigned char epd_bitmap_Adown[] PROGMEM = {
  0x00, 0x00, 0x00, 0x00, 0x00, 0x00, 0x00, 0x00, 0x00, 0x3f, 0xff, 0xe0, 0x00, 0x00, 0x00, 0x03,
  0xff, 0xff, 0xfc, 0x00, 0x00, 0x00, 0x1f, 0xff, 0xff, 0xff, 0x80, 0x00, 0x00, 0xff, 0xff, 0xff,
  0xff, 0xc0, 0x00, 0x01, 0xff, 0xff, 0xff, 0xff, 0xf0, 0x00, 0x07, 0xff, 0xff, 0xff, 0xff, 0xf8,
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  0x00, 0x00
};
// 'Aup', 73x80px
const unsigned char epd_bitmap_Aup[] PROGMEM = {
  0x00, 0x00, 0x00, 0x00, 0x00, 0x00, 0x00, 0x00, 0x00, 0x00, 0x00, 0x00, 0x00, 0x1f, 0xff, 0xf8,
  0x00, 0x00, 0x00, 0x00, 0x00, 0x00, 0x00, 0x3f, 0xff, 0xfc, 0x00, 0x00, 0x00, 0x00, 0x00, 0x00,
  0x00, 0x3f, 0xff, 0xfe, 0x00, 0x00, 0x00, 0x00, 0x00, 0x00, 0x00, 0x3f, 0xff, 0xfe, 0x00, 0x00,
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  0x00, 0x00, 0x00, 0x7f, 0xff, 0x00, 0x00, 0x00, 0x00, 0x00, 0x00, 0x00, 0x00, 0x00, 0x00, 0x00
};

// 'ASCII', 88x28px
const unsigned char epd_bitmap_ASCII[] PROGMEM = {
  0x00, 0x00, 0x00, 0x00, 0x00, 0x00, 0x00, 0x00, 0x00, 0x00, 0x00, 0x00, 0x7f, 0x00, 0x00, 0xff,
  0x80, 0x01, 0xff, 0x00, 0xf0, 0x1e, 0x00, 0x7f, 0x00, 0x03, 0xff, 0xc0, 0x07, 0xff, 0xc0, 0xf0,
  0x1e, 0x00, 0x7f, 0x00, 0x07, 0xff, 0xc0, 0x0f, 0xff, 0xc0, 0xf0, 0x1e, 0x00, 0xff, 0x80, 0x0f,
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  0x00, 0x00, 0x00, 0x00
};

// 'HTML', 100x27px
const unsigned char epd_bitmap_HTML[] PROGMEM = {
  0x00, 0x00, 0x00, 0x00, 0x00, 0x00, 0x00, 0x00, 0x00, 0x00, 0x00, 0x00, 0x00, 0x78, 0x00, 0xf8,
  0x7f, 0xff, 0xf0, 0x7f, 0x00, 0x01, 0xfe, 0x03, 0xc0, 0x00, 0x78, 0x00, 0xf8, 0x7f, 0xff, 0xf0,
  0xff, 0x80, 0x01, 0xfe, 0x03, 0xc0, 0x00, 0x78, 0x00, 0xf8, 0x7f, 0xff, 0xf0, 0xff, 0x80, 0x03,
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  0xff, 0xe0, 0x00, 0x00, 0x00, 0x00, 0x00, 0x00, 0x00, 0x00, 0x00, 0x00, 0x00, 0x00, 0x00
};


const int epd_bitmap_allArray_LEN = 19;
const unsigned char* epd_bitmap_allArray[19] = {
  epd_bitmap_Adown,  //50x62px
  epd_bitmap_Aup,    //73x80px
  epd_bitmap_Cdown,  //45x83px
  epd_bitmap_Cup,    //59x103px
  epd_bitmap_Edown,  //54x62px
  epd_bitmap_Eup,    //47x79px
  epd_bitmap_Euro,   //59x82px
  epd_bitmap_Idown,  //16x60px
  epd_bitmap_Iup,    //16x80px
  epd_bitmap_Ndown,  //52x85px
  epd_bitmap_Nup,    //66x102px
  epd_bitmap_Odown,  //59x62px
  epd_bitmap_Oup,    //75x82px
  epd_bitmap_Udown,  //52x61px
  epd_bitmap_Uup,    //65x81px
  epd_bitmap_deg,    //34x32px
  epd_bitmap_dots,   //43x16px
  epd_bitmap_left,   //29x19px
  epd_bitmap_right   //29x19px
};

unsigned long lastMillis;     //variables for input debouncing
unsigned long currentMillis;
long debounceTime = 200;

const int hpix[] = { 50, 73, 45, 59, 54, 47, 59, 16, 16, 52, 66, 59, 75, 52, 65, 34, 43, 29, 29 };    //lengths and widths of all the bitmaps
const int vpix[] = { 62, 80, 83, 103, 62, 79, 82, 60, 80, 85, 102, 62, 82, 61, 81, 32, 16, 19, 19 };

//for keeping track of current selected character
int accentState = 0;   // 0 = left, 1 = right, 3 = dots
int vowelState = 0;    // 0 = a, 1 = e, 2 = i, 3 = o, 4 = u
int specialState = 0;  // 0 = Ñ, 2 = ñ, 3 = Ç, 4 = ç, 5 = °, 6 = €

bool capState = false;
bool isHTML = true;
bool isSpecial = false;

//lookup tables for location of bitmaps
int charPosCap[] = { 1, 5, 8, 12, 14 };     //A E I O U
int charPosNotCap[] = { 0, 4, 7, 11, 13 };  //a e i o u
int accentPos[] = { 17, 18, 16 };           //left, right, dots
int specialPos[] = { 10, 9, 2, 3, 15, 6 };  //Ñ ñ Ç ç ° €

uint8_t numKeys[] = {  //numpad for 0-9. Used to type ASCII characters
  KEY_NUM_0,
  KEY_NUM_1,
  KEY_NUM_2,
  KEY_NUM_3,
  KEY_NUM_4,
  KEY_NUM_5,
  KEY_NUM_6,
  KEY_NUM_7,
  KEY_NUM_8,
  KEY_NUM_9,
};


String htmlEntityCap[][5] = {                                      //strings for capitalized HTML enitities
  { "&Agrave;", "&Egrave;", "&Igrave;", "&Ograve;", "&Ugrave;" },
  { "&Aacute;", "&Eacute;", "&Iacute;", "&Oacute;", "&Uacute;" },
  { "&Auml;", "&Euml;", "&Iuml;", "&Ouml;", "&Uuml;" }
};  // [accent] [vowel]  left right dots   a e i o u

String htmlEntityNotCap[][5] = {                                   //strings for non capitalized HTML enitities
  { "&agrave;", "&egrave;", "&igrave;", "&ograve;", "&ugrave;" },
  { "&aacute;", "&eacute;", "&iacute;", "&oacute;", "&uacute;" },
  { "&auml;", "&euml;", "&iuml;", "&ouml;", "&uuml;" }
};  // [accent] [vowel]  left right dots   a e i o u

int ASCIICap[][5] = {             //values to type when typing capitalized ASCII charcters. like pressing Alt then 0224 on numpad
  { 192, 200, 204, 210, 217 },
  { 193, 201, 205, 211, 218 },
  { 196, 203, 207, 214, 220 }
};  // [accent] [vowel]  left right dots   a e i o u

int ASCIINotCap[][5] = {           //values to type when typing non-capitalized ASCII charcters
  { 224, 232, 236, 242, 249 },
  { 225, 233, 237, 243, 250 },
  { 228, 235, 239, 246, 252 }
};  // [accent] [vowel]  left right dots   a e i o u

//strings and number for the special characters:
String htmlSpecial[] = { "&Ntilde;", "&ntilde;", "&ccedil;", "&Ccedil;", "&deg;", "&euro;" };  //Ñ ñ ç Ç ° €

int ASCIISpecial[] = { 209, 241, 231, 199, 176, 128 };  //Ñ ñ ç Ç ° €

/*flag is the type of action that the last button press was.
flag = 0 represents a change in a standard character. Could be a different vowel, different accent mark, or toggling upper/lower case
flag = 1 represents switching to the next special character
flag = 2 represents pressing the enter key
flag = 3 represents chaning between ASCII / HTML
*/

int flag = 0;
int lastFlag = 0;

bool lastFormat;

bool buttonStates[12];


void setup() {

  for (int i = 0; i < 3; i++) {
    pinMode(buttonRows[i], OUTPUT);
  }
  for (int i = 0; i < 4; i++) {
    pinMode(buttonColumns[i], INPUT);
  }
  tft.init(135, 240);
  tft.fillScreen(ST77XX_BLACK);
  bleKeyboard.begin();

  for (int i = 0; i < 240; i++) {
    for (int j = 0; j < 135; j++) {
      tft.drawPixel(j, i, 5 * ((135 * i) + j));
    }
  }
}


void loop() {

  if ( !(flag == -1 || flag == 2 || flag == 3) ){
    lastFlag = flag;
  }

  flag = updateButtonStates();

  if (buttonStates[1]) {
    vowelState = 0;
  }
  if (buttonStates[2]) {
    vowelState = 1;
  }
  if (buttonStates[3]) {
    vowelState = 2;
  }
  if (buttonStates[5]) {
    vowelState = 3;
  }
  if (buttonStates[6]) {
    vowelState = 4;
  }
  if (buttonStates[7]) {
    capState = !capState;
  }
  if (buttonStates[9]) {
    accentState++;
    if (accentState > 2) {
      accentState = 0;
    }
  }

  if (flag == 0) {
    isSpecial = false;
    if (capState) {
      tft.fillRect(0, 40, 135, 200, ST77XX_BLACK);
      drawVowel(charPosCap[vowelState]);
      drawAccent(accentPos[accentState], charPosCap[vowelState]);
      updatePreview(flag);

    } else {
      tft.fillRect(0, 40, 135, 200, ST77XX_BLACK);
      drawVowel(charPosNotCap[vowelState]);
      drawAccent(accentPos[accentState], charPosNotCap[vowelState]);
      updatePreview(flag);
    }
    updateFormatIndicator();
  }

  if (flag == 1) {
    isSpecial = true;
    specialState++;
    if (specialState > 5) {
      specialState = 0;
    }
    tft.fillRect(0, 40, 135, 200, ST77XX_BLACK);
    drawSpecial(specialPos[specialState]);
    updateFormatIndicator();
    updatePreview(flag);
  }

  if (flag == 2) {
    if (!isSpecial) {
      if (isHTML) {
        if (capState) {
          bleKeyboard.print(htmlEntityCap[accentState][vowelState]);
        } else {
          bleKeyboard.print(htmlEntityNotCap[accentState][vowelState]);
        }
      } else {
        if (capState) {
          typeAscii(ASCIICap[accentState][vowelState]);
        } else {
          typeAscii(ASCIINotCap[accentState][vowelState]);
        }
      }
    } else {
      if (isHTML) {
        bleKeyboard.print(htmlSpecial[specialState]);
      } else {
        typeAscii(ASCIISpecial[specialState]);
      }
    }
  }

  if (flag == 3) {
    isHTML = !isHTML;
    updateFormatIndicator();
    updatePreview(flag);
  }
}



int updateButtonStates() {

  currentMillis = millis();

  bool lastButtonStates[12];  //last button state is kept track of in order to only trigger a button press on a rising edge, 
                              //not anytime the button is currently pressed. Along with debouncing this triggers an event consistantly once per real button press

  for (int i = 0; i < 12; i++) {
    lastButtonStates[i] = buttonStates[i];
  }

  for (int row = 0; row < 3; row++) {
    digitalWrite(buttonRows[0], LOW);
    digitalWrite(buttonRows[1], LOW);
    digitalWrite(buttonRows[2], LOW);

    digitalWrite(buttonRows[row], HIGH);

    for (int column = 0; column < 4; column++) {
      buttonStates[(4 * row) + column] = digitalRead(buttonColumns[column]);
    }
  }

  for (int i = 0; i < 12; i++) {
    if (currentMillis - lastMillis > debounceTime) {           //only check for button press if debounce delay has elapsed since last recorded time
      if ((i <= 7) && buttonStates[i] && !lastButtonStates[i]) {    //rising edge occurs when last state was false, and current state is true. 
        lastMillis = currentMillis;                                 //if this is the case, then record the time
        return 0;
      }
      if ((i == 9) && buttonStates[i] && !lastButtonStates[i]) {
        lastMillis = currentMillis;
        return 0;
      }
      if ((i == 10) && buttonStates[i] && !lastButtonStates[i]) {
        lastMillis = currentMillis;
        return 1;
      }
      if ((i == 8) && buttonStates[i] && !lastButtonStates[i]) {
        lastMillis = currentMillis;
        return 2;
      }
      if ((i == 11) && buttonStates[i] && !lastButtonStates[i]) {
        lastMillis = currentMillis;
        return 3;
      }
    }
  }
  return -1; //this should never happen
}

void drawVowel(int index) {
  tft.drawBitmap(67 - int(hpix[index] / 2), 160 - vpix[index], epd_bitmap_allArray[index], hpix[index], vpix[index], 0x2e9e); //draw a vowel on screen, centered horizontally and 160 pixels down verticaly
}

void drawAccent(int acindex, int vwindex) {   
  if (acindex == 17) {   //accent to the left. Drawn slightly to the left so that the bottom is aligned with the center. Drawn just above whatever character is below it.
    tft.drawBitmap(59 - int(hpix[acindex] / 2), 155 - vpix[acindex] - vpix[vwindex], epd_bitmap_allArray[acindex], hpix[acindex], vpix[acindex], 0xd374);
    return;
  }
  if (acindex == 18) {   //accent to the right. Drawn slightly to the right so that the bottom is aligned with the center. Drawn just above whatever character is below it.
    tft.drawBitmap(75 - int(hpix[acindex] / 2), 155 - vpix[acindex] - vpix[vwindex], epd_bitmap_allArray[acindex], hpix[acindex], vpix[acindex], 0xd374);
    return;
  }                      //else draw dots. Drawn centered horizontally, and just above whatever chracater is below it.
  tft.drawBitmap(67 - int(hpix[acindex] / 2), 155 - vpix[acindex] - vpix[vwindex], epd_bitmap_allArray[acindex], hpix[acindex], vpix[acindex], 0xd374);
}

void drawSpecial(int index) {
  if (index == 15) {
    tft.drawBitmap(90 - int(hpix[index] / 2), 100 - vpix[index], epd_bitmap_allArray[index], hpix[index], vpix[index], 0x64da);  //for degree symbol only draw it up to the right
    return;
  }
  tft.drawBitmap(67 - int(hpix[index] / 2), 160 - vpix[index], epd_bitmap_allArray[index], hpix[index], vpix[index], 0x64da);  //for all other special character draw it centered horizontally, and 160 pixels down verticaly
}

void typeAscii(int code) {   
  bleKeyboard.press(KEY_LEFT_ALT);                    //type ASCII character by pressing alt, then typing in numpad code. 
  bleKeyboard.write(KEY_NUM_0);                       //All of these charcaters start with 0 so it was omitted from lookup tables and put in here.
  bleKeyboard.write(numKeys[code / 100]);             //hundreths place digit
  bleKeyboard.write(numKeys[(code % 100) / 10]);      //tenths place digit
  bleKeyboard.write(numKeys[(code % 100) % 10]);      //ones place digit
  bleKeyboard.releaseAll();                           //release alt key
}

void updateFormatIndicator() {                                    //draw the image for HTML or ASCII
  if (lastFormat != isHTML) {                                     //even if the function was called, only draw the image if it changed since last call
    tft.fillRect(0, 0, 135, 40, ST77XX_BLACK);
    if (isHTML) {
      tft.drawBitmap(17, 5, epd_bitmap_HTML, 100, 27, 0x8e28);
      tft.drawRoundRect(12, 0, 110, 37, 4, 0xce44);
    } else {
      tft.drawBitmap(23, 5, epd_bitmap_ASCII, 88, 28, 0x8e28);
      tft.drawRoundRect(18, 0, 98, 38, 4, 0xce44);
    }
  }
  lastFormat = isHTML;                                            //keep track of last state
}

void updatePreview(int flagState) {            //draw text on bottum of screen that previews what the board wil type
  if (flagState == 3) {                        //if the last buttom press was changing from html/ascii, then use the last real change as a reference for drawing the preview
    flagState = lastFlag;
  }
  tft.setTextSize(3);
  tft.setCursor(0, 190);
  tft.setTextColor(0x645b);
  tft.setTextWrap(false);
  if (flagState == 0) {
    tft.fillRect(0, 190, 135, 50, ST77XX_BLACK);
    if (capState) {
      if (isHTML) {
        tft.print(htmlEntityCap[accentState][vowelState]);
      } else {
        tft.println("Alt+");
        tft.print("0");
        tft.print(ASCIICap[accentState][vowelState]);
      }
      return;
    } else {
      if (isHTML) {
        tft.print(htmlEntityNotCap[accentState][vowelState]);
      } else {
        tft.println("Alt+");
        tft.print("0");
        tft.print(ASCIINotCap[accentState][vowelState]);
      }
      return;
    }
  }
  if (flagState == 1) {
    tft.fillRect(0, 190, 135, 50, ST77XX_BLACK);

    if (isHTML) {
      tft.print(htmlSpecial[specialState]);
      return;
    } else {
      tft.println("Alt+");
      tft.print("0");
      tft.print(ASCIISpecial[specialState]);
      return;
    }
  }
  return;
}
